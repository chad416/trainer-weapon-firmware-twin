## CMakeLists.txt
```
cmake_minimum_required(VERSION 3.20)
find_package(Zephyr REQUIRED HINTS $ENV{ZEPHYR_BASE})
project(trainer_unit)

# Pure logic modules from the application, tested without any hardware.
set(APP_SRC ${CMAKE_CURRENT_SOURCE_DIR}/../../app/src)

target_include_directories(app PRIVATE
	src
	${APP_SRC}/trigger
	${APP_SRC}/weapon
	${APP_SRC}/proto
	${APP_SRC}/cfg
	${APP_SRC}/imu
	${APP_SRC}/timesync
	${APP_SRC}/strobe
)

target_sources(app PRIVATE
	src/test_rounds.c
	src/test_trigger.c
	src/test_weapon.c
	src/test_proto.c
	src/test_cfg.c
	src/test_imu.c
	src/test_malfunction.c
	src/test_timesync.c
	src/test_shotlog.c
	src/test_strobe.c
	${APP_SRC}/trigger/trigger_proc.c
	${APP_SRC}/weapon/rounds.c
	${APP_SRC}/weapon/weapon_sm.c
	${APP_SRC}/weapon/malfunction.c
	${APP_SRC}/weapon/shotlog.c
	${APP_SRC}/proto/proto.c
	${APP_SRC}/cfg/cfg.c
	${APP_SRC}/imu/imu_metrics.c
	${APP_SRC}/timesync/timesync.c
	${APP_SRC}/strobe/strobe.c
)
```

## prj.conf
```kconfig
CONFIG_ZTEST=y
CONFIG_SMF=y
CONFIG_SMF_ANCESTOR_SUPPORT=y
CONFIG_CRC=y
```

## src/proto_vectors.h
```c
/* GENERATED by protocol/gen_vectors.py from protocol/trainer.dbc. Do not edit. */
#ifndef TRAINER_PROTO_VECTORS_H_
#define TRAINER_PROTO_VECTORS_H_

#include <stdint.h>

/* SYNC (ID 0x080): {"isotp_pci": 4, "lane_time_us": 3735928559} */
static const uint8_t VEC_SYNC[5] = {0x04, 0xEF, 0xBE, 0xAD, 0xDE};

/* SHOT_EVENT_N1 (ID 0x101): {"shot_no": 4660, "t_us": 2712847316, "mode": 2, "chambered": 1, "rounds_left": 29} */
static const uint8_t VEC_SHOT_EVENT[8] = {0x34, 0x12, 0xD4, 0xC3, 0xB2, 0xA1, 0x06, 0x1D};

/* SHOT_DETAIL_N1 (ID 0x181): {"shot_no": 7, "takeup_ms": 120, "squeeze_ms": 44, "jerk": 30, "muzzle_rate": 12, "cant": -5, "flinch": 1.5} */
static const uint8_t VEC_SHOT_DETAIL[8] = {0x07, 0x00, 0x1E, 0x0B, 0x1E, 0x0C, 0xFB, 0x0F};

/* STATUS_N1 (ID 0x201): {"state": 5, "sel": 2, "mag_in": 1, "chambered": 1, "stoppage": 0, "rounds": 28, "faults": 264, "tx_overflows": 3, "tx_errors": 5, "shots": 515} */
static const uint8_t VEC_STATUS[8] = {0x05, 0xAE, 0x1C, 0x08, 0x01, 0x03, 0x03, 0x02};

/* EVENT_N1 (ID 0x281): {"type": 6, "t_us": 16909060, "value": 2500} */
static const uint8_t VEC_EVENT[8] = {0x06, 0x00, 0x04, 0x03, 0x02, 0x01, 0xC4, 0x09};

/* BIT_RESULT_N1 (ID 0x301): {"fault_mask": 20, "critical": 1} */
static const uint8_t VEC_BIT_RESULT[8] = {0x14, 0x00, 0x01, 0x00, 0x00, 0x00, 0x00, 0x00};

/* CMD_N1 (ID 0x381): {"isotp_pci": 6, "opcode": 2, "key": 3, "value": 900} */
static const uint8_t VEC_CMD[7] = {0x06, 0x02, 0x03, 0x84, 0x03, 0x00, 0x00};

/* CMD_ACK_N1 (ID 0x401): {"isotp_pci": 7, "opcode": 2, "key": 3, "status": 0, "value": 900} */
static const uint8_t VEC_CMD_ACK[8] = {0x07, 0x02, 0x03, 0x00, 0x84, 0x03, 0x00, 0x00};

/* INFO_N1 (ID 0x481): {"ver_major": 0, "ver_minor": 2, "ver_patch": 0, "reset_reason": 3, "boot_count": 42} */
static const uint8_t VEC_INFO[8] = {0x00, 0x02, 0x00, 0x03, 0x2A, 0x00, 0x00, 0x00};

#endif /* TRAINER_PROTO_VECTORS_H_ */
```

## src/test_cfg.c
```c
/* SPEC F13, R03: configuration validation, key access and CRC-protected storage form. */
#include <string.h>
#include <zephyr/ztest.h>

#include "cfg.h"

static struct trainer_cfg c;

static void before(void *fixture)
{
	ARG_UNUSED(fixture);
	cfg_defaults(&c);
}

ZTEST_SUITE(cfg, NULL, NULL, before, NULL, NULL);

ZTEST(cfg, test_defaults_are_valid)
{
	zassert_true(cfg_valid(&c));
	zassert_equal(c.node_id, 1);
	zassert_equal(c.capacity, 30);
	zassert_equal(c.auto_rpm, 750);
}

ZTEST(cfg, test_set_and_get_every_key)
{
	static const struct {
		uint8_t key;
		uint32_t value;
	} cases[] = {
		{CFG_KEY_NODE_ID, 42},     {CFG_KEY_CAPACITY, 20},  {CFG_KEY_AUTO_RPM, 900},
		{CFG_KEY_EMITTER_US, 500}, {CFG_KEY_VALVE_MS, 30},  {CFG_KEY_BREAK_PM, 800},
		{CFG_KEY_RESET_PM, 600},
	};

	for (size_t i = 0; i < ARRAY_SIZE(cases); i++) {
		uint32_t got;

		zassert_equal(cfg_set_key(&c, cases[i].key, cases[i].value), CFG_OK, "key %u",
			      cases[i].key);
		zassert_equal(cfg_get_key(&c, cases[i].key, &got), CFG_OK);
		zassert_equal(got, cases[i].value, "key %u", cases[i].key);
	}
}

ZTEST(cfg, test_rejects_out_of_range_and_keeps_old_value)
{
	zassert_equal(cfg_set_key(&c, CFG_KEY_AUTO_RPM, 1200), CFG_BAD_VALUE);
	zassert_equal(cfg_set_key(&c, CFG_KEY_NODE_ID, 0), CFG_BAD_VALUE);
	zassert_equal(cfg_set_key(&c, CFG_KEY_NODE_ID, 128), CFG_BAD_VALUE);
	zassert_equal(cfg_set_key(&c, CFG_KEY_CAPACITY, 70000), CFG_BAD_VALUE);
	zassert_equal(c.auto_rpm, 750, "rejected set must not change the config");
	zassert_equal(c.node_id, 1);
}

ZTEST(cfg, test_reset_must_stay_below_break)
{
	zassert_equal(cfg_set_key(&c, CFG_KEY_RESET_PM, 700), CFG_BAD_VALUE, "reset == break");
	zassert_equal(cfg_set_key(&c, CFG_KEY_BREAK_PM, 450), CFG_BAD_VALUE, "break below reset");
	zassert_equal(cfg_set_key(&c, CFG_KEY_RESET_PM, 420), CFG_OK);
	zassert_equal(cfg_set_key(&c, CFG_KEY_BREAK_PM, 450), CFG_OK, "now it fits");
}

ZTEST(cfg, test_unknown_key)
{
	uint32_t v;

	zassert_equal(cfg_get_key(&c, 99, &v), CFG_BAD_KEY);
	zassert_equal(cfg_set_key(&c, 99, 1), CFG_BAD_KEY);
	zassert_equal(cfg_set_key(&c, 99, 100000), CFG_BAD_KEY);
}

ZTEST(cfg, test_serialize_round_trip)
{
	uint8_t blob[CFG_BLOB_LEN];
	struct trainer_cfg back;

	(void)cfg_set_key(&c, CFG_KEY_NODE_ID, 7);
	(void)cfg_set_key(&c, CFG_KEY_AUTO_RPM, 880);
	cfg_serialize(&c, blob);
	zassert_true(cfg_deserialize(blob, sizeof(blob), &back));
	zassert_mem_equal(&back, &c, sizeof(c));
}

ZTEST(cfg, test_corruption_is_detected)
{
	uint8_t blob[CFG_BLOB_LEN];
	struct trainer_cfg back;

	cfg_serialize(&c, blob);
	blob[3] ^= 0x01; /* one bit flip in auto_rpm */
	zassert_false(cfg_deserialize(blob, sizeof(blob), &back), "CRC must catch a bit flip");

	cfg_serialize(&c, blob);
	blob[0] = CFG_VERSION + 1U;
	zassert_false(cfg_deserialize(blob, sizeof(blob), &back), "unknown version");

	cfg_serialize(&c, blob);
	zassert_false(cfg_deserialize(blob, sizeof(blob) - 1U, &back), "wrong length");
}
```

## src/test_imu.c
```c
/* SPEC F10: IMU pre-shot metrics. */
#include <math.h>
#include <zephyr/ztest.h>

#include "imu_metrics.h"

#define PERIOD_US 5000U /* 200 Hz */

static struct imu_ring ring;

static void push(uint32_t t_us, float gy, float gz, float ay, float az)
{
	struct imu_sample s = {.t_us = t_us, .gx = 0.0f, .gy = gy, .gz = gz,
			       .ax = 0.0f, .ay = ay, .az = az};

	imu_ring_push(&ring, &s);
}

static void before(void *fixture)
{
	ARG_UNUSED(fixture);
	imu_ring_init(&ring);
}

ZTEST_SUITE(imu, NULL, NULL, before, NULL, NULL);

ZTEST(imu, test_no_samples)
{
	struct imu_shot_metrics m;

	zassert_false(imu_compute_metrics(&ring, 1000000U, &m));
	zassert_equal(m.samples, 0);
}

ZTEST(imu, test_constant_rate_and_flinch)
{
	struct imu_shot_metrics m;

	/* 1 s of a steady 20 deg/s pitch rate; shot exactly on a sample. */
	for (uint32_t t = 0U; t <= 1000000U; t += PERIOD_US) {
		push(t, 20.0f, 0.0f, 0.0f, 1.0f);
	}
	zassert_true(imu_compute_metrics(&ring, 1000000U, &m));
	zassert_within(m.muzzle_rate_dps, 20.0f, 0.01f);
	/* 50 ms at 20 deg/s = 1 deg: samples at -50..-5 ms cover 50 ms exactly. */
	zassert_within(m.flinch_deg, 1.0f, 0.11f);
	zassert_within(m.samples, 61, 1, "300 ms at 200 Hz");
}

ZTEST(imu, test_rate_uses_pitch_and_yaw_not_roll)
{
	struct imu_shot_metrics m;

	for (uint32_t t = 0U; t <= 400000U; t += PERIOD_US) {
		struct imu_sample s = {.t_us = t, .gx = 100.0f, .gy = 3.0f, .gz = 4.0f,
				       .ay = 0.0f, .az = 1.0f};

		imu_ring_push(&ring, &s);
	}
	zassert_true(imu_compute_metrics(&ring, 400000U, &m));
	zassert_within(m.muzzle_rate_dps, 5.0f, 0.01f, "sqrt(3^2 + 4^2), roll ignored");
}

ZTEST(imu, test_cant_from_gravity)
{
	struct imu_shot_metrics m;
	float r = 10.0f * 3.14159265f / 180.0f;

	for (uint32_t t = 0U; t <= 400000U; t += PERIOD_US) {
		push(t, 0.0f, 0.0f, sinf(r), cosf(r));
	}
	zassert_true(imu_compute_metrics(&ring, 400000U, &m));
	zassert_within(m.cant_deg, 10.0f, 0.01f);
}

ZTEST(imu, test_flinch_only_counts_last_50_ms)
{
	struct imu_shot_metrics m;

	/* Steady until 950 ms, then a dip of 30 deg/s. Shot at 1000 ms. */
	for (uint32_t t = 0U; t <= 1000000U; t += PERIOD_US) {
		push(t, (t >= 950000U) ? 30.0f : 0.0f, 0.0f, 0.0f, 1.0f);
	}
	zassert_true(imu_compute_metrics(&ring, 1000000U, &m));
	zassert_within(m.flinch_deg, 1.5f, 0.16f, "30 deg/s for 50 ms");

	/* A dip long before the shot does not count as flinch. */
	imu_ring_init(&ring);
	for (uint32_t t = 0U; t <= 1000000U; t += PERIOD_US) {
		push(t, ((t >= 700000U) && (t < 800000U)) ? 30.0f : 0.0f, 0.0f, 0.0f, 1.0f);
	}
	zassert_true(imu_compute_metrics(&ring, 1000000U, &m));
	zassert_within(m.flinch_deg, 0.0f, 0.001f);
	zassert_true(m.muzzle_rate_dps > 5.0f, "but it does raise the 300 ms rate");
}

ZTEST(imu, test_samples_after_the_shot_are_ignored)
{
	struct imu_shot_metrics m;

	for (uint32_t t = 0U; t <= 500000U; t += PERIOD_US) {
		push(t, 0.0f, 0.0f, 0.0f, 1.0f);
	}
	for (uint32_t t = 505000U; t <= 600000U; t += PERIOD_US) {
		push(t, 500.0f, 500.0f, 0.0f, 1.0f); /* recoil after the shot */
	}
	zassert_true(imu_compute_metrics(&ring, 500000U, &m));
	zassert_within(m.muzzle_rate_dps, 0.0f, 0.001f);
	zassert_within(m.flinch_deg, 0.0f, 0.001f);
}

ZTEST(imu, test_clock_wraparound)
{
	struct imu_shot_metrics m;
	uint32_t t0 = UINT32_MAX - 200000U;

	for (uint32_t i = 0U; i <= 80U; i++) {
		push(t0 + (i * PERIOD_US), 20.0f, 0.0f, 0.0f, 1.0f);
	}
	zassert_true(imu_compute_metrics(&ring, t0 + (80U * PERIOD_US), &m));
	zassert_within(m.muzzle_rate_dps, 20.0f, 0.01f);
	zassert_within(m.flinch_deg, 1.0f, 0.11f);
}
```

## src/test_malfunction.c
```c
/* SPEC F08: stoppage injection modes and clearance window. */
#include <zephyr/ztest.h>

#include "malfunction.h"

static struct malf m;

static void before(void *fixture)
{
	ARG_UNUSED(fixture);
	malf_init(&m);
}

ZTEST_SUITE(malfunction, NULL, NULL, before, NULL, NULL);

ZTEST(malfunction, test_off_never_stops)
{
	malf_on_mag_insert(&m);
	for (int i = 0; i < 200; i++) {
		zassert_false(malf_on_round(&m, (uint32_t)i));
	}
}

ZTEST(malfunction, test_at_round_n_once_per_magazine)
{
	zassert_equal(malf_set_key(&m, MALF_KEY_MODE, MALF_AT_ROUND), 0);
	zassert_equal(malf_set_key(&m, MALF_KEY_ROUND, 5), 0);

	for (int mag = 0; mag < 2; mag++) {
		malf_on_mag_insert(&m);
		for (int r = 1; r <= 30; r++) {
			zassert_equal(malf_on_round(&m, 0U), r == 5, "mag %d round %d", mag, r);
		}
	}
}

ZTEST(malfunction, test_random_extremes)
{
	zassert_equal(malf_set_key(&m, MALF_KEY_MODE, MALF_RANDOM), 0);

	zassert_equal(malf_set_key(&m, MALF_KEY_PROB_PM, 1000), 0);
	for (uint32_t i = 0; i < 100U; i++) {
		zassert_true(malf_on_round(&m, i * 2654435761U), "p = 1000 always stops");
	}
	zassert_equal(malf_set_key(&m, MALF_KEY_PROB_PM, 0), 0);
	for (uint32_t i = 0; i < 100U; i++) {
		zassert_false(malf_on_round(&m, i * 2654435761U), "p = 0 never stops");
	}
}

ZTEST(malfunction, test_random_rate)
{
	uint32_t x = 12345U;
	int stops = 0;

	(void)malf_set_key(&m, MALF_KEY_MODE, MALF_RANDOM);
	(void)malf_set_key(&m, MALF_KEY_PROB_PM, 100); /* 10 % */
	for (int i = 0; i < 10000; i++) {
		x ^= x << 13;
		x ^= x >> 17;
		x ^= x << 5;
		stops += malf_on_round(&m, x) ? 1 : 0;
	}
	zassert_within(stops, 1000, 100, "about 10 %% of 10000 rounds, got %d", stops);
}

ZTEST(malfunction, test_key_validation)
{
	uint32_t v;

	zassert_equal(malf_set_key(&m, MALF_KEY_MODE, 3), 3);
	zassert_equal(malf_set_key(&m, MALF_KEY_ROUND, 0), 3);
	zassert_equal(malf_set_key(&m, MALF_KEY_ROUND, 101), 3);
	zassert_equal(malf_set_key(&m, MALF_KEY_PROB_PM, 1001), 3);
	zassert_equal(malf_set_key(&m, MALF_KEY_CLEAR_WINDOW_MS, 50), 3);
	zassert_equal(malf_set_key(&m, MALF_KEY_CLEAR_WINDOW_MS, 0), 0, "0 = no limit");
	zassert_equal(malf_set_key(&m, 99, 1), 2);
	zassert_equal(malf_get_key(&m, 99, &v), 2);
	zassert_equal(malf_get_key(&m, MALF_KEY_ROUND, &v), 0);
	zassert_equal(v, 5, "default round");
}

ZTEST(malfunction, test_clear_window)
{
	zassert_false(malf_clear_late(&m, 60000U), "no window: never late");
	(void)malf_set_key(&m, MALF_KEY_CLEAR_WINDOW_MS, 2000);
	zassert_false(malf_clear_late(&m, 2000U));
	zassert_true(malf_clear_late(&m, 2001U));
}
```

## src/test_proto.c
```c
/* SPEC §6: firmware encoders must match the DBC byte for byte (vectors generated from the DBC). */
#include <zephyr/ztest.h>

#include "proto.h"
#include "proto_vectors.h"

ZTEST_SUITE(proto, NULL, NULL, NULL, NULL, NULL);

ZTEST(proto, test_ids)
{
	zassert_equal(proto_id(PROTO_FN_SYNC, 0), 0x080);
	zassert_equal(proto_id(PROTO_FN_SHOT_EVENT, 1), 0x101);
	zassert_equal(proto_id(PROTO_FN_CMD, 2), 0x382);
	zassert_equal(proto_id(PROTO_FN_INFO, 127), 0x4FF);
	zassert_equal(proto_id_function(0x382), PROTO_FN_CMD);
	zassert_equal(proto_id_node(0x382), 2);
}

ZTEST(proto, test_shot_event_matches_dbc)
{
	struct proto_shot_event m = {
		.shot_no = 4660, .t_us = 2712847316U, .mode = 2, .chambered = true, .rounds_left = 29};
	uint8_t out[PROTO_FRAME_LEN];

	zassert_equal(proto_encode_shot_event(&m, out), sizeof(VEC_SHOT_EVENT));
	zassert_mem_equal(out, VEC_SHOT_EVENT, sizeof(VEC_SHOT_EVENT));
}

ZTEST(proto, test_sync_matches_dbc_and_round_trips)
{
	uint8_t out[PROTO_FRAME_LEN];
	uint32_t back;
	uint8_t len = proto_encode_sync(3735928559U, out);

	zassert_equal(len, sizeof(VEC_SYNC));
	zassert_mem_equal(out, VEC_SYNC, sizeof(VEC_SYNC));
	zassert_true(proto_decode_sync(out, len, &back));
	zassert_equal(back, 3735928559U);
	zassert_false(proto_decode_sync(VEC_CMD, sizeof(VEC_CMD), &back), "a CMD is not a SYNC");
}

ZTEST(proto, test_shot_detail_matches_dbc)
{
	/* take-up 120 ms and squeeze 44 ms in 4 ms steps */
	struct proto_shot_detail m = {.shot_no = 7, .takeup_4ms = 30, .squeeze_4ms = 11,
				      .jerk_pm_per_ms = 30, .muzzle_rate_dps = 12, .cant_deg = -5,
				      .flinch_ddeg = 15};
	uint8_t out[PROTO_FRAME_LEN];

	zassert_equal(proto_encode_shot_detail(&m, out), sizeof(VEC_SHOT_DETAIL));
	zassert_mem_equal(out, VEC_SHOT_DETAIL, sizeof(VEC_SHOT_DETAIL));
}

ZTEST(proto, test_saturation)
{
	zassert_equal(proto_sat_u8(-3), 0);
	zassert_equal(proto_sat_u8(300), 255);
	zassert_equal(proto_sat_i8(-200), -128);
	zassert_equal(proto_sat_i8(200), 127);
	zassert_equal(proto_sat_i8(-5), -5);
}

ZTEST(proto, test_status_matches_dbc)
{
	struct proto_status m = {.state = 5, .sel = 2, .mag_in = true, .chambered = true,
				 .stoppage = false, .rounds = 28, .faults = 264, .tx_overflows = 3,
				 .tx_errors = 5, .shots = 515};
	uint8_t out[PROTO_FRAME_LEN];

	zassert_equal(proto_encode_status(&m, out), sizeof(VEC_STATUS));
	zassert_mem_equal(out, VEC_STATUS, sizeof(VEC_STATUS));

	/* tx_errors has 3 bits: it saturates at 7 and leaves the other flags alone. */
	m.tx_errors = 200;
	(void)proto_encode_status(&m, out);
	zassert_equal(out[1] >> 5, 7);
	zassert_equal(out[1] & 0x1FU, VEC_STATUS[1] & 0x1FU);
}

ZTEST(proto, test_event_matches_dbc)
{
	struct proto_event m = {.type = 6, .t_us = 16909060U, .value = 2500};
	uint8_t out[PROTO_FRAME_LEN];

	zassert_equal(proto_encode_event(&m, out), sizeof(VEC_EVENT));
	zassert_mem_equal(out, VEC_EVENT, sizeof(VEC_EVENT));
}

ZTEST(proto, test_bit_result_matches_dbc)
{
	struct proto_bit_result m = {.fault_mask = 20, .critical = true};
	uint8_t out[PROTO_FRAME_LEN];

	zassert_equal(proto_encode_bit_result(&m, out), sizeof(VEC_BIT_RESULT));
	zassert_mem_equal(out, VEC_BIT_RESULT, sizeof(VEC_BIT_RESULT));
}

ZTEST(proto, test_cmd_matches_dbc_and_round_trips)
{
	struct proto_cmd m = {.opcode = 2, .key = 3, .value = 900};
	struct proto_cmd back;
	uint8_t out[PROTO_FRAME_LEN];
	uint8_t len = proto_encode_cmd(&m, out);

	zassert_equal(len, sizeof(VEC_CMD));
	zassert_mem_equal(out, VEC_CMD, sizeof(VEC_CMD));
	zassert_true(proto_decode_cmd(out, len, &back));
	zassert_equal(back.opcode, 2);
	zassert_equal(back.key, 3);
	zassert_equal(back.value, 900);
}

ZTEST(proto, test_cmd_ack_matches_dbc)
{
	struct proto_cmd_ack m = {.opcode = 2, .key = 3, .status = 0, .value = 900};
	uint8_t out[PROTO_FRAME_LEN];

	zassert_equal(proto_encode_cmd_ack(&m, out), sizeof(VEC_CMD_ACK));
	zassert_mem_equal(out, VEC_CMD_ACK, sizeof(VEC_CMD_ACK));
}

ZTEST(proto, test_info_matches_dbc)
{
	struct proto_info m = {.ver_major = 0, .ver_minor = 2, .ver_patch = 0, .reset_reason = 3,
			       .boot_count = 42};
	uint8_t out[PROTO_FRAME_LEN];

	zassert_equal(proto_encode_info(&m, out), sizeof(VEC_INFO));
	zassert_mem_equal(out, VEC_INFO, sizeof(VEC_INFO));
}

ZTEST(proto, test_cmd_decode_rejects_bad_frames)
{
	struct proto_cmd c;
	uint8_t padded[8] = {0x06, 0x01, 0x02, 0, 0, 0, 0, 0xCC};
	uint8_t first_frame[8] = {0x10, 0x08, 0x01, 0x02, 0, 0, 0, 0}; /* ISO-TP first frame */
	uint8_t wrong_len[7] = {0x05, 0x01, 0x02, 0, 0, 0, 0};

	zassert_true(proto_decode_cmd(padded, 8, &c), "padding after the payload is allowed");
	zassert_false(proto_decode_cmd(first_frame, 8, &c), "multi-frame is not a CMD");
	zassert_false(proto_decode_cmd(wrong_len, 7, &c), "PCI length must be 6");
	zassert_false(proto_decode_cmd(padded, 6, &c), "frame shorter than the payload");
}
```

## src/test_rounds.c
```c
/* SPEC F04, F05, F07: magazine and chamber logic, including "30 + 1". */
#include <zephyr/ztest.h>

#include "rounds.h"

static struct rounds r;

static void before(void *fixture)
{
	ARG_UNUSED(fixture);
	rounds_init(&r, 30);
}

ZTEST_SUITE(rounds, NULL, NULL, before, NULL, NULL);

ZTEST(rounds, test_init_empty)
{
	zassert_false(r.mag_in);
	zassert_false(r.chambered);
	zassert_equal(rounds_total(&r), 0);
}

ZTEST(rounds, test_insert_gives_full_mag_nothing_chambered)
{
	rounds_insert_mag(&r);
	zassert_true(r.mag_in);
	zassert_equal(r.mag_rounds, 30);
	zassert_false(r.chambered);
}

ZTEST(rounds, test_insert_twice_is_ignored)
{
	rounds_insert_mag(&r);
	(void)rounds_rack(&r);
	rounds_insert_mag(&r);
	zassert_equal(r.mag_rounds, 29, "second insert must not refill");
}

ZTEST(rounds, test_rack_chambers_from_mag)
{
	rounds_insert_mag(&r);
	zassert_false(rounds_rack(&r), "nothing to eject");
	zassert_true(r.chambered);
	zassert_equal(r.mag_rounds, 29);
	zassert_equal(rounds_total(&r), 30);
}

ZTEST(rounds, test_rack_with_round_chambered_ejects_it)
{
	rounds_insert_mag(&r);
	(void)rounds_rack(&r);
	zassert_true(rounds_rack(&r), "chambered round must be ejected");
	zassert_true(r.chambered);
	zassert_equal(rounds_total(&r), 29);
}

ZTEST(rounds, test_fire_auto_feeds)
{
	rounds_insert_mag(&r);
	(void)rounds_rack(&r);
	zassert_true(rounds_fire(&r));
	zassert_true(r.chambered);
	zassert_equal(rounds_total(&r), 29);
}

ZTEST(rounds, test_full_mag_gives_exactly_capacity_shots)
{
	int shots = 0;

	rounds_insert_mag(&r);
	(void)rounds_rack(&r);
	while (rounds_fire(&r)) {
		shots++;
	}
	zassert_equal(shots, 30);
	zassert_false(r.chambered);
	zassert_false(rounds_fire(&r), "empty chamber is a dry fire");
}

ZTEST(rounds, test_remove_mag_keeps_chambered_round)
{
	rounds_insert_mag(&r);
	(void)rounds_rack(&r);
	rounds_remove_mag(&r);
	zassert_true(r.chambered);
	zassert_equal(rounds_total(&r), 1);
}

ZTEST(rounds, test_thirty_plus_one)
{
	rounds_insert_mag(&r);
	(void)rounds_rack(&r);
	rounds_remove_mag(&r);
	rounds_insert_mag(&r);
	zassert_equal(rounds_total(&r), 31);
}
```

## src/test_shotlog.c
```c
/* SPEC F15: on-device shot log (ring buffer of the last 1000 shots). */
#include <zephyr/ztest.h>

#include "shotlog.h"

static struct shotlog slog;

static struct shot_record rec(uint16_t n)
{
	return (struct shot_record){.shot_no = n, .t_lane_us = 1000U * n, .rounds_left = 7,
				    .flinch_ddeg = -3};
}

static void add_n(uint16_t first, uint16_t n)
{
	for (uint16_t i = 0; i < n; i++) {
		struct shot_record r = rec((uint16_t)(first + i));

		shotlog_add(&slog, &r);
	}
}

static void before(void *fixture)
{
	ARG_UNUSED(fixture);
	shotlog_init(&slog);
}

ZTEST_SUITE(shotlog, NULL, NULL, before, NULL, NULL);

ZTEST(shotlog, test_record_is_16_bytes)
{
	zassert_equal(sizeof(struct shot_record), 16, "1000 records = 16 KB of RAM");
}

ZTEST(shotlog, test_empty)
{
	struct shot_record r;

	zassert_equal(shotlog_count(&slog), 0);
	zassert_equal(shotlog_total(&slog), 0);
	zassert_false(shotlog_get(&slog, 0, &r));
}

ZTEST(shotlog, test_newest_first_by_age)
{
	struct shot_record r;

	add_n(1, 3);
	zassert_equal(shotlog_count(&slog), 3);
	zassert_true(shotlog_get(&slog, 0, &r));
	zassert_equal(r.shot_no, 3, "age 0 is the newest");
	zassert_true(shotlog_get(&slog, 2, &r));
	zassert_equal(r.shot_no, 1, "age count-1 is the oldest");
	zassert_equal(r.t_lane_us, 1000U);
	zassert_equal(r.flinch_ddeg, -3, "signed fields survive");
	zassert_false(shotlog_get(&slog, 3, &r));
}

ZTEST(shotlog, test_full_buffer_keeps_last_1000)
{
	struct shot_record r;

	add_n(1, 1000);
	zassert_equal(shotlog_count(&slog), 1000);
	zassert_true(shotlog_get(&slog, 999, &r));
	zassert_equal(r.shot_no, 1);

	add_n(1001, 5); /* overwrites shots 1..5 */
	zassert_equal(shotlog_count(&slog), 1000);
	zassert_equal(shotlog_total(&slog), 1005);
	zassert_true(shotlog_get(&slog, 0, &r));
	zassert_equal(r.shot_no, 1005);
	zassert_true(shotlog_get(&slog, 999, &r));
	zassert_equal(r.shot_no, 6, "oldest held after overwriting 5");
}

ZTEST(shotlog, test_every_record_in_order_after_wrap)
{
	struct shot_record r;

	add_n(1, 2500);
	for (uint16_t age = 0; age < 1000; age++) {
		zassert_true(shotlog_get(&slog, age, &r));
		zassert_equal(r.shot_no, 2500 - age, "age %u", age);
	}
}
```

## src/test_strobe.c
```c
/*
 * SPEC F17 (v0.6): emitter strobing on lane time. Aim pulses in the weapon's
 * slot, the shot pulse in the first exposure >= 2 ms after the break,
 * replacing that frame's aim pulse; late shots; configuration limits.
 */
#include <zephyr/ztest.h>

#include "strobe.h"
#include "timesync.h"

ZTEST_SUITE(strobe, NULL, NULL, NULL, NULL, NULL);

ZTEST(strobe, test_config)
{
	zassert_true(strobe_cfg_ok(0, 0), "direct mode");
	zassert_true(strobe_cfg_ok(2, 1));
	zassert_true(strobe_cfg_ok(4, 3));
	zassert_false(strobe_cfg_ok(1, 0), "one slot: no dark frame for the tracker's background");
	zassert_false(strobe_cfg_ok(5, 0));
	zassert_false(strobe_cfg_ok(2, 2));
	zassert_false(strobe_cfg_ok(0, 4));

	struct strobe_cfg off = {0, 0};
	struct strobe_pulse p;

	zassert_false(strobe_next(&off, 0, STROBE_NO_SHOT, &p), "direct mode has no schedule");
}

ZTEST(strobe, test_shot_frame_rule)
{
	/* The same rule as the tracker (aimtrk/match.h). */
	zassert_equal(strobe_pulse_start(3), 34750);
	zassert_equal(strobe_shot_frame(0), 0);
	zassert_equal(strobe_shot_frame(2750), 0, "exactly the margin");
	zassert_equal(strobe_shot_frame(2751), 1);
	zassert_equal(strobe_shot_frame(123456789), 12346);
	zassert_equal(strobe_shot_frame(-7751), -1);
}

ZTEST(strobe, test_aim_pulses_in_slot)
{
	struct strobe_cfg c = {.n_slots = 3, .slot = 2};
	struct strobe_pulse p;
	int64_t t = 1000000;

	for (int i = 0; i < 10; i++) {
		zassert_true(strobe_next(&c, t, STROBE_NO_SHOT, &p));
		zassert_equal(p.kind, STROBE_AIM);
		zassert_equal(p.k % 3, 2, "slot");
		zassert_equal(p.start_us, (p.k * 10000) + 4750);
		zassert_true(p.start_us >= t);
		zassert_true((p.start_us - t) < 30000, "the next one, not a later one");
		zassert_false(p.late);
		t = p.start_us + 1;
	}
	/* Exactly at a pulse start: that pulse. */
	zassert_true(strobe_next(&c, 24750, STROBE_NO_SHOT, &p));
	zassert_equal(p.k, 2);
	/* Negative lane times (before the lane's zero) work too. */
	zassert_true(strobe_next(&c, -15000, STROBE_NO_SHOT, &p));
	zassert_equal(p.k, -1);
}

ZTEST(strobe, test_shot_pulse)
{
	struct strobe_cfg c = {.n_slots = 2, .slot = 0};
	struct strobe_pulse p;

	/* Break at 101.5 ms: shot frame 10 (pulse 104.75 ms), our aim slot: the shot replaces the aim. */
	int64_t k = strobe_shot_frame(101500);

	zassert_equal(k, 10);
	zassert_true(strobe_next(&c, 101800, k, &p));
	zassert_equal(p.kind, STROBE_SHOT);
	zassert_equal(p.k, 10);
	zassert_false(p.late);

	/* Break at 111.5 ms: shot frame 11, the other slot; it comes before our next aim (12). */
	k = strobe_shot_frame(111500);
	zassert_equal(k, 11);
	zassert_true(strobe_next(&c, 111800, k, &p));
	zassert_equal(p.kind, STROBE_SHOT);
	zassert_equal(p.k, 11);

	/* A shot frame further away than our next aim pulse: the aim pulse comes first. */
	zassert_true(strobe_next(&c, 100000, 13, &p));
	zassert_equal(p.kind, STROBE_AIM);
	zassert_equal(p.k, 10);

	/* Late: the shot frame's pulse has already started; the next exposure, flagged. */
	zassert_true(strobe_next(&c, 105000, 10, &p));
	zassert_equal(p.kind, STROBE_SHOT);
	zassert_equal(p.k, 11);
	zassert_true(p.late);
}

/* The inverse of the SYNC fit, used to time the pulses (v0.6). */
ZTEST(strobe, test_timesync_inverse)
{
	struct timesync ts;

	ts_init(&ts);
	zassert_equal(ts_lane_time64(&ts, 1234), 1234);
	zassert_equal(ts_local_time(&ts, 1234), 1234U);
	/* Local clock 100 ppm fast, lane offset +5 s, across the 32-bit wrap of the lane clock. */
	for (int i = 0; i < 40; i++) {
		uint64_t local = 1000000ULL + (uint64_t)(i * 10001);
		int64_t lane = 4294967296LL - 200000 + ((int64_t)i * 10000);

		ts_add(&ts, local, (uint32_t)lane);
	}
	int64_t lane = ts_lane_time64(&ts, 1000000ULL + 39 * 10001);

	zassert_within(lane, 4294967296LL + 190000, 2, "unwrapped: %lld", (long long)lane);
	for (int64_t l = 4294967296LL; l < 4294967296LL + 500000; l += 7919) {
		uint64_t local = ts_local_time(&ts, l);

		zassert_within(ts_lane_time64(&ts, local), l, 1, "round trip at %lld", (long long)l);
	}
}
```

## src/test_timesync.c
```c
/* SPEC F12, T03: lane time synchronisation (offset, drift, jitter, wrap, restart). */
#include <stdlib.h>
#include <zephyr/ztest.h>

#include "timesync.h"

static struct timesync ts;

static void before(void *fixture)
{
	ARG_UNUSED(fixture);
	ts_init(&ts);
}

ZTEST_SUITE(timesync, NULL, NULL, before, NULL, NULL);

/* Lane clock as a function of the node's local clock. */
static int64_t lane_of(uint64_t local_us, int64_t offset_us, double drift_ppm)
{
	return (int64_t)((double)local_us * (1.0 + (drift_ppm * 1e-6))) + offset_us;
}

/* Feed SYNC every 10 ms with +-jitter us of reception jitter; return worst error afterwards. */
static int64_t run(int64_t offset_us, double drift_ppm, int jitter_us, int n_sync)
{
	uint32_t seed = 1U;
	uint64_t local = 1000000U;

	for (int i = 0; i < n_sync; i++) {
		seed = (seed * 1103515245U) + 12345U;
		int j = (jitter_us > 0) ? ((int)(seed >> 16) % (2 * jitter_us + 1)) - jitter_us : 0;

		ts_add(&ts, local + (uint64_t)(int64_t)j,
		       (uint32_t)lane_of(local, offset_us, drift_ppm));
		local += 10000U;
	}

	/* Predict lane time over the next 100 ms (ten missed SYNC periods), worst error. */
	int64_t worst = 0;

	for (uint64_t t = local; t < local + 100000U; t += 5000U) {
		int64_t err = (int64_t)(uint32_t)lane_of(t, offset_us, drift_ppm) -
			      (int64_t)ts_lane_time(&ts, t);

		/* compare on the 32-bit circle */
		err = (int64_t)(int32_t)(uint32_t)err;
		if (llabs(err) > worst) {
			worst = llabs(err);
		}
	}
	return worst;
}

ZTEST(timesync, test_unsynced_is_local)
{
	zassert_false(ts.synced);
	zassert_equal(ts_lane_time(&ts, 123456U), 123456U);
}

ZTEST(timesync, test_pure_offset)
{
	int64_t worst = run(5000000, 0.0, 0, 20);

	zassert_true(ts.synced);
	zassert_true(worst <= 1, "worst error %lld us", worst);
}

ZTEST(timesync, test_drift_plus_200ppm_with_jitter)
{
	int64_t worst = run(-2500000, 200.0, 5, 100);

	zassert_true(worst <= 50, "worst error %lld us (SPEC: <= 50)", worst);
	zassert_within(ts_drift_ppm(&ts), 200.0, 20.0);
}

ZTEST(timesync, test_drift_minus_200ppm_with_jitter)
{
	int64_t worst = run(777777, -200.0, 5, 100);

	zassert_true(worst <= 50, "worst error %lld us (SPEC: <= 50)", worst);
	zassert_within(ts_drift_ppm(&ts), -200.0, 20.0);
}

ZTEST(timesync, test_heavy_jitter_keeps_drift_bounded)
{
	/* +-3 ms reception jitter (under the 10 ms restart threshold): the slope must stay sane. */
	(void)run(1000000, 0.0, 3000, 200);
	zassert_true(ts_drift_ppm(&ts) <= 500.0 + 1e-6, "drift %d ppm", (int)ts_drift_ppm(&ts));
	zassert_true(ts_drift_ppm(&ts) >= -500.0 - 1e-6, "drift %d ppm", (int)ts_drift_ppm(&ts));
}

ZTEST(timesync, test_single_sync_is_pure_offset)
{
	ts_add(&ts, 1000000U, 6000000U);
	zassert_true(ts.synced);
	zassert_equal(ts_lane_time(&ts, 1234567U), 6234567U);
	zassert_equal(ts_offset_us(&ts, 1234567U), 5000000);
}

ZTEST(timesync, test_lane_clock_wrap)
{
	/* Lane clock starts 50 ms before its 32-bit wrap. */
	int64_t offset = (int64_t)UINT32_MAX - 50000 - 1000000;
	int64_t worst = run(offset, 0.0, 0, 20);

	zassert_true(worst <= 1, "worst error %lld us", worst);
	zassert_equal(ts.resets, 0, "a wrap is not a restart");
}

ZTEST(timesync, test_lane_restart_resets_the_fit)
{
	(void)run(5000000, 0.0, 0, 20);
	zassert_equal(ts.resets, 0);

	/* Lane restarts: its clock jumps back to near zero. */
	uint64_t local = 2000000U;

	for (int i = 0; i < 5; i++) {
		ts_add(&ts, local, (uint32_t)(1000 + (i * 10000)));
		local += 10000U;
	}
	zassert_equal(ts.resets, 1);
	zassert_within((int64_t)ts_lane_time(&ts, local), 1000 + (5 * 10000), 2);
}
```

## src/test_trigger.c
```c
/* SPEC F01, F02, F10 (trigger part), R04: trigger calibration, hysteresis, metrics. */
#include <zephyr/ztest.h>

#include "trigger_proc.h"

static struct trig_cal cal;
static struct trig_proc tp;

/*
 * Raw ADC value that converts back to exactly `pm` with the default 12-bit
 * calibration. Rounds up, because the conversion back to permille floors.
 */
static int32_t raw_for(uint16_t pm)
{
	return (((int32_t)pm * 4095) + 999) / 1000;
}

static enum trig_event feed(uint16_t pm, uint32_t t_ms)
{
	return trig_update(&tp, raw_for(pm), t_ms * 1000U);
}

static void before(void *fixture)
{
	ARG_UNUSED(fixture);
	trig_cal_default(&cal);
	trig_init(&tp, &cal);
}

ZTEST_SUITE(trigger, NULL, NULL, before, NULL, NULL);

ZTEST(trigger, test_travel_conversion_and_clamp)
{
	zassert_equal(trig_travel_pm(&cal, 0), 0);
	zassert_equal(trig_travel_pm(&cal, 4095), 1000);
	zassert_within(trig_travel_pm(&cal, 2048), 500, 1);
	zassert_equal(trig_travel_pm(&cal, -100), 0, "below rest clamps to 0");
	zassert_equal(trig_travel_pm(&cal, 5000), 1000, "above full clamps to 1000");
}

ZTEST(trigger, test_inverted_sensor)
{
	cal.rest_raw = 4095;
	cal.full_raw = 0;
	zassert_equal(trig_travel_pm(&cal, 4095), 0);
	zassert_equal(trig_travel_pm(&cal, 0), 1000);
}

ZTEST(trigger, test_calibration_validation)
{
	zassert_true(trig_cal_valid(&cal));

	struct trig_cal bad = cal;

	bad.reset_pm = bad.break_pm;
	zassert_false(trig_cal_valid(&bad), "reset must be below break");

	bad = cal;
	bad.full_raw = bad.rest_raw;
	zassert_false(trig_cal_valid(&bad), "zero span");

	bad = cal;
	bad.wall_pm = bad.takeup_pm;
	zassert_false(trig_cal_valid(&bad), "take-up must be below wall");
}

ZTEST(trigger, test_held_at_power_up_does_not_fire)
{
	zassert_equal(feed(1000, 0), TRIG_EV_NONE, "held trigger at boot must not break");
	zassert_equal(feed(1000, 1), TRIG_EV_NONE);
	zassert_equal(feed(0, 2), TRIG_EV_NONE, "release without a break is not a reset");
	zassert_equal(feed(800, 3), TRIG_EV_BREAK, "armed after one release");
}

ZTEST(trigger, test_hysteresis)
{
	zassert_equal(feed(0, 0), TRIG_EV_NONE);
	zassert_equal(feed(750, 1), TRIG_EV_BREAK);
	zassert_equal(feed(800, 2), TRIG_EV_NONE, "holding is not a second break");
	zassert_equal(feed(600, 3), TRIG_EV_NONE, "above reset: still not re-armed");
	zassert_equal(feed(800, 4), TRIG_EV_NONE, "no break without a reset");
	zassert_equal(feed(400, 5), TRIG_EV_RESET);
	zassert_equal(feed(400, 6), TRIG_EV_NONE, "reset is reported once");
	zassert_equal(feed(800, 7), TRIG_EV_BREAK);
}

ZTEST(trigger, test_exact_thresholds)
{
	(void)feed(0, 0);
	zassert_equal(feed(699, 1), TRIG_EV_NONE, "just below break");
	zassert_equal(feed(700, 2), TRIG_EV_BREAK, "break is inclusive");
	zassert_equal(feed(500, 3), TRIG_EV_NONE, "reset is exclusive");
	zassert_equal(feed(499, 4), TRIG_EV_RESET);
}

ZTEST(trigger, test_squeeze_metrics)
{
	(void)feed(0, 0);
	(void)feed(150, 10); /* first movement at 10 ms */
	(void)feed(450, 20); /* wall at 20 ms */
	zassert_equal(feed(750, 40), TRIG_EV_BREAK);

	const struct trig_metrics *m = trig_last_metrics(&tp);

	zassert_equal(m->takeup_ms, 10);
	zassert_equal(m->squeeze_ms, 20);
	zassert_equal(m->jerk_pm_per_ms, 30, "fastest segment: 300 pm in 10 ms");
}

ZTEST(trigger, test_slap_in_one_sample)
{
	(void)feed(0, 0);
	zassert_equal(feed(1000, 1), TRIG_EV_BREAK);

	const struct trig_metrics *m = trig_last_metrics(&tp);

	zassert_equal(m->takeup_ms, 0);
	zassert_equal(m->squeeze_ms, 0);
	zassert_equal(m->jerk_pm_per_ms, 1000);
}

ZTEST(trigger, test_time_wraparound)
{
	uint32_t t0 = UINT32_MAX - 5000U; /* 5 ms before the 32-bit us counter wraps */

	(void)trig_update(&tp, raw_for(0), t0);
	(void)trig_update(&tp, raw_for(150), t0 + 1000U);
	(void)trig_update(&tp, raw_for(450), t0 + 4000U);
	zassert_equal(trig_update(&tp, raw_for(750), t0 + 9000U), TRIG_EV_BREAK);
	zassert_equal(trig_last_metrics(&tp)->takeup_ms, 3);
	zassert_equal(trig_last_metrics(&tp)->squeeze_ms, 5);
}
```

## src/test_weapon.c
```c
/* SPEC F03-F08, R04: weapon state machine. */
#include <zephyr/ztest.h>

#include "weapon_sm.h"

static struct weapon w;
static uint32_t now_ms;

static uint32_t send(enum weapon_event_type type)
{
	struct weapon_event ev = {.type = type, .t_ms = now_ms};

	now_ms += 10U;
	return weapon_handle(&w, &ev);
}

static void before(void *fixture)
{
	ARG_UNUSED(fixture);
	now_ms = 0U;
	weapon_init(&w, 30);
}

/* SAFE -> SEMI, magazine in, rack: READY with 30 rounds. */
static void load_semi(void)
{
	(void)send(WEV_SELECTOR_CYCLE);
	(void)send(WEV_MAG_TOGGLE);
	(void)send(WEV_RACK);
	zassert_equal(weapon_state(&w), WS_READY);
}

ZTEST_SUITE(weapon, NULL, NULL, before, NULL, NULL);

ZTEST(weapon, test_powers_up_safe)
{
	zassert_equal(weapon_state(&w), WS_SAFE);
	zassert_equal(w.sel, SEL_SAFE);
}

ZTEST(weapon, test_trigger_blocked_in_safe)
{
	(void)send(WEV_MAG_TOGGLE);
	(void)send(WEV_RACK);
	uint32_t act = send(WEV_TRIGGER_BREAK);

	zassert_false(act & (WACT_FIRE | WACT_DRY_FIRE));
	zassert_equal(w.shots, 0);
	zassert_equal(weapon_state(&w), WS_SAFE, "loading works in SAFE, firing does not");
}

ZTEST(weapon, test_selector_cycle)
{
	(void)send(WEV_SELECTOR_CYCLE);
	zassert_equal(w.sel, SEL_SEMI);
	(void)send(WEV_SELECTOR_CYCLE);
	zassert_equal(w.sel, SEL_AUTO);
	(void)send(WEV_SELECTOR_CYCLE);
	zassert_equal(w.sel, SEL_SAFE);
	zassert_equal(weapon_state(&w), WS_SAFE);
}

ZTEST(weapon, test_empty_and_loaded_are_dry_fire)
{
	(void)send(WEV_SELECTOR_CYCLE);
	zassert_equal(weapon_state(&w), WS_EMPTY);
	zassert_true(send(WEV_TRIGGER_BREAK) & WACT_DRY_FIRE);
	(void)send(WEV_TRIGGER_RESET);

	(void)send(WEV_MAG_TOGGLE);
	zassert_equal(weapon_state(&w), WS_LOADED, "magazine in but not racked");
	zassert_true(send(WEV_TRIGGER_BREAK) & WACT_DRY_FIRE);
	zassert_equal(w.shots, 0);
}

ZTEST(weapon, test_semi_one_shot_per_break)
{
	load_semi();
	zassert_true(send(WEV_TRIGGER_BREAK) & WACT_FIRE);
	zassert_equal(weapon_state(&w), WS_FIRING);
	zassert_false(send(WEV_CADENCE_TICK) & WACT_FIRE, "no cadence in SEMI");
	(void)send(WEV_TRIGGER_RESET);
	zassert_equal(weapon_state(&w), WS_READY);
	zassert_true(send(WEV_TRIGGER_BREAK) & WACT_FIRE);
	zassert_equal(w.shots, 2);
	zassert_equal(rounds_total(&w.rounds), 28);
}

ZTEST(weapon, test_auto_cadence)
{
	load_semi();
	(void)send(WEV_SELECTOR_CYCLE); /* AUTO */

	uint32_t act = send(WEV_TRIGGER_BREAK);

	zassert_true(act & WACT_FIRE);
	zassert_true(act & WACT_CADENCE_START);
	for (int i = 0; i < 5; i++) {
		zassert_true(send(WEV_CADENCE_TICK) & WACT_FIRE);
	}
	act = send(WEV_TRIGGER_RESET);
	zassert_true(act & WACT_CADENCE_STOP);
	zassert_equal(weapon_state(&w), WS_READY);
	zassert_equal(w.shots, 6);
}

ZTEST(weapon, test_auto_runs_dry_and_stops_cadence)
{
	weapon_init(&w, 3);
	load_semi();
	(void)send(WEV_SELECTOR_CYCLE); /* AUTO */
	zassert_true(send(WEV_TRIGGER_BREAK) & WACT_CADENCE_START);
	(void)send(WEV_CADENCE_TICK);

	uint32_t act = send(WEV_CADENCE_TICK); /* third and last round */

	zassert_true(act & WACT_FIRE);
	zassert_true(act & WACT_CADENCE_STOP);
	zassert_equal(weapon_state(&w), WS_EMPTY);
	zassert_equal(w.shots, 3);
}

/* Regression: firing the last round from READY in AUTO must not start a cadence. */
ZTEST(weapon, test_auto_last_round_does_not_start_cadence)
{
	weapon_init(&w, 1);
	load_semi();
	(void)send(WEV_SELECTOR_CYCLE); /* AUTO */

	uint32_t act = send(WEV_TRIGGER_BREAK);

	zassert_true(act & WACT_FIRE);
	zassert_false(act & WACT_CADENCE_START);
	zassert_equal(weapon_state(&w), WS_EMPTY);
}

ZTEST(weapon, test_safe_while_firing_stops_and_keeps_rounds)
{
	load_semi();
	(void)send(WEV_SELECTOR_CYCLE); /* AUTO */
	(void)send(WEV_TRIGGER_BREAK);

	uint8_t left = rounds_total(&w.rounds);
	uint32_t act = send(WEV_SELECTOR_CYCLE); /* AUTO -> SAFE */

	zassert_true(act & WACT_CADENCE_STOP);
	zassert_equal(weapon_state(&w), WS_SAFE);
	zassert_equal(rounds_total(&w.rounds), left);
}

ZTEST(weapon, test_held_trigger_when_leaving_safe_does_not_fire)
{
	(void)send(WEV_MAG_TOGGLE);
	(void)send(WEV_RACK);
	(void)send(WEV_TRIGGER_BREAK); /* held in SAFE */

	uint32_t act = send(WEV_SELECTOR_CYCLE);

	zassert_false(act & WACT_FIRE);
	zassert_equal(weapon_state(&w), WS_FIRING, "waiting for the trigger to reset");
	(void)send(WEV_TRIGGER_RESET);
	zassert_true(send(WEV_TRIGGER_BREAK) & WACT_FIRE);
}

ZTEST(weapon, test_stoppage_drill)
{
	load_semi();
	now_ms = 1000U;
	zassert_true(send(WEV_STOPPAGE_INJECT) & WACT_STOPPAGE_START);
	zassert_equal(weapon_state(&w), WS_STOPPAGE);

	zassert_false(send(WEV_TRIGGER_BREAK) & (WACT_FIRE | WACT_DRY_FIRE));
	(void)send(WEV_TRIGGER_RESET);

	(void)send(WEV_RACK); /* wrong order: rack before tap */
	zassert_equal(weapon_state(&w), WS_STOPPAGE);

	uint8_t before_clear = rounds_total(&w.rounds);

	(void)send(WEV_TAP);
	now_ms = 3500U;

	uint32_t act = send(WEV_RACK);

	zassert_true(act & WACT_STOPPAGE_CLEAR);
	zassert_equal(weapon_state(&w), WS_READY);
	zassert_equal(w.last_clear_ms, 2500U);
	zassert_equal(rounds_total(&w.rounds), before_clear - 1, "dud round ejected");
}

ZTEST(weapon, test_fault_blocks_fire)
{
	load_semi();
	(void)send(WEV_FAULT_SET);
	zassert_equal(weapon_state(&w), WS_FAULT);
	zassert_false(send(WEV_TRIGGER_BREAK) & WACT_FIRE);
	(void)send(WEV_TRIGGER_RESET);
	(void)send(WEV_FAULT_CLEAR);
	zassert_equal(weapon_state(&w), WS_READY);
}

ZTEST(weapon, test_state_names)
{
	zassert_str_equal(weapon_state_name(WS_READY), "READY");
	zassert_str_equal(weapon_selector_name(SEL_AUTO), "AUTO");
	zassert_str_equal(weapon_state_name(WS_COUNT), "?");
}
```
